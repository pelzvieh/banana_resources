// Definitions for dht11 module
/*
Adapted from dht11.dts for Raspberrypi, by Keith Hall
Adapted by pelzi.
*/
/dts-v1/;
/plugin/;

/ {
        /* compatible = "sinovoip,bpi-m2-zero", "allwinner,sun8i-h2-plus"; */

        fragment@0 {
                target-path = "/";
                __overlay__ {

                        temperature_humidity: dht11@6 {
                                compatible = "dht22", "dht11";
                                pinctrl-names = "default";
                                pinctrl-0 = <&dht11_pins>;
                                gpios = <&pio 0 6 0>; /* PA6 (PIN 7), active high */
                                status = "okay";
                        };

                };
        };

        fragment@1 {
                target = <&pio>;
                __overlay__ {
			input-debounce = <5 0>; /* 5ms debounce on IRQ bank 0, default on bank 1 */
                        dht11_pins: dht11_pins {
                                pins = "PA6";
                                function = "gpio_in";
                                /*bias-pull-up; not required for 3-pin version of sensor */
                        };
                };
        };

        __overrides__ {
                gpiopin =       <&dht11_pins>,"pins:0",
                                <&temperature_humidity>,"gpios:8";
        };
};
